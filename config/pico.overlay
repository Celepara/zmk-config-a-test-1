// config/pico.overlay - Simplified for LED Timeout

/ {
    // 1. Define the 'led_off' behavior
    behaviors {
        led_off: led_off_behavior {
            compatible = "zmk,behavior-output-status";
            label = "LED_OFF";
            output-state = <0>; // 0 = OFF
            trigger-delay-ms = <5000>; // 5 seconds delay
        };
    };
};

// 2. Apply the behavior to the Pi Pico's LED
&pico_led {
    status = "okay";
    turn-off-behavior = <&led_off>;
};
